## arch/lambdasoc/Kconfig
```kconfig
#
# For a description of the syntax of this configuration file,
# see the file kconfig-language.txt in the NuttX tools repository.
#

if ARCH_LAMBDASOC

choice
	prompt "Misoc Chip Selection"
	default ARCH_CHIP_MINERVA

config ARCH_CHIP_MINERVA
	bool "MINERVA"
	select LAMBDASOC_HAVE_UART1
	---help---
		LambdaConcept MINERVA Chip Selected

config ARCH_CHIP_LAMBDASOC_CUSTOM
	bool "Custom LAMBDASOC chip"
	select ARCH_CHIP_CUSTOM
	---help---
		Select this option if there is no directory for the chip under arch/lambdasoc/src/.

endchoice # Misoc Chip Selection

config ARCH_CHIP
	string
	default "minerva"	if ARCH_CHIP_MINERVA

menu "LAMBDASOC Peripheral Support"

# These "hidden" settings determine whether a peripheral option is available
# for the selected MCU

config LAMBDASOC_CLOCK_FREQUENCY
	int "SoC clock frequency"

config LAMBDASOC_HAVE_UART1
	bool
	default n
	select UART1_SERIALDRIVER

config LAMBDASOC_UART1
	bool "UART1"
	default n
	select ARCH_HAVE_UART1
	select LAMBDASOC_UART

config LAMBDASOC_TIMER
	bool "Timer"
	default n

config LAMBDASOC_ETHERNET
	bool "Ethernet"
	default n
	select NETDEVICES
	select ARCH_HAVE_PHY
	select ARCH_HAVE_NETDEV_STATISTICS

endmenu # LAMBDASOC Peripheral Support

config LAMBDASOC_UART
	bool

config LAMBDASOC_UART_RX_BUF_SIZE
	int "UART RX Buffer size"
	default 64
	depends on LAMBDASOC_UART
	---help---
		Size of RX buffers for LAMBDASOC UARTs

config LAMBDASOC_UART_TX_BUF_SIZE
	int "UART TX Buffer size"
	default 64
	depends on LAMBDASOC_UART
	---help---
		Size of TX buffers for LAMBDASOC UARTs

if ARCH_CHIP_MINERVA
source arch/lambdasoc/src/minerva/Kconfig
endif

endif # ARCH_LAMBDASOC
```
